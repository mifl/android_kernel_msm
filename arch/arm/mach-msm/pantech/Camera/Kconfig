## arch/arm/mach-msm/pantech/Camera/Kconfig
```kconfig
if CUST_PANTECH_H

###################################################
# PANTECH Camera Feature Section                  #
#                                                 #
###################################################
# * Defined Camera common feature                 #
###################################################

###################################################
# * Defined Camera board feature                  #
###################################################

if MACH_MSM8974_EF56S
config DEFINE_LIST_EF56S
	bool
	default y
	select PANTECH_CAMERA_EF56_SS

endif

if MACH_MSM8974_EF59S
config DEFINE_LIST_EF59S
	bool
	default y
	select PANTECH_CAMERA_EF59_SS
endif

if MACH_MSM8974_EF59K
config DEFINE_LIST_EF59K
	bool
	default y
	select PANTECH_CAMERA_EF59_SS
endif

if MACH_MSM8974_EF59L
config DEFINE_LIST_EF59L
	bool
	default y
	select PANTECH_CAMERA_EF59_SS
endif

if MACH_MSM8974_EF60S
config DEFINE_LIST_EF60S
	bool
	default y
	select PANTECH_CAMERA_EF60_SS
endif

if MACH_MSM8974_EF61K
config DEFINE_LIST_EF61K
	bool
	default y
	select PANTECH_CAMERA_EF60_SS
endif

if MACH_MSM8974_EF62L
config DEFINE_LIST_EF62L
	bool
	default y
	select PANTECH_CAMERA_EF60_SS
endif

##############################################################
# owner  : p12484
# date    : 2013.12.05
# Description : board feature
##############################################################
config PANTECH_CAMERA_EF56_SS
	bool

config PANTECH_CAMERA_EF59_SS
	bool

config PANTECH_CAMERA_EF60_SS
	bool

endif
```

## arch/arm/mach-msm/pantech/LCD/Kconfig
```kconfig
if CUST_PANTECH_H

menu "SKY GPU/Display Configuration"

###################################################
# PANTECH LCD Feature Section                     #
#                                                 #
###################################################
# * Defined LCD common feature                    #
###################################################
config MACH_MSM8974_LCD_COMMON
	bool
	default y
	select F_SKYDISP_LCD_RESET
	select F_SKYDISP_LCD_FORCE_ONOFF
	select F_SKYDISP_SHARPNESS_CTRL
	select F_SKYDISP_BACKLIGHT_DEBUG
	select F_SKYDISP_SILENT_BOOT
	select F_SKYDISP_CMDS_CONTROL
	select F_SKYDISP_BACKLIGHT_CMDS_CTL
	select F_SKYDISP_FACTORY_SLEEP_ENABLE
	select F_QUALCOMM_VIDEO_PLAYER_HALT
	select F_SKYDISP_ADJUST_MDP_BANDWIDTH
	select F_QUALCOMM_BUGFIX_SURFACEFLINGER_PENDING
	select F_QUALCOMM_BUGFIX_MDP_UNDERRUN
	select F_QUALCOMM_MOVIE_PLAYER_MDP_UNDERRUN
	select F_QUALCOMM_WORKAROUND_FOR_GDSC_OXILI_FAIL
	select F_SKYDISP_FIX_PINGPONG_TIMEOUT_BY_CLOCK

###################################################
# * Defined LCD board feature                     #
###################################################

if MACH_MSM8974_EF63K
config DEFINE_LIST_EF63K
	bool
	default y
	select F_SKYDISP_EF63_SS
	select F_SKYDISP_HBM_FOR_AMOLED
	select F_SKYDISP_ELVSS_WORK
	select F_SKYDISP_SMARTDIMMING
	select F_SKYDISP_EF63_DRIVER_IC_CHECK
	select F_SKYDISP_AMOLED_READ_DATA
	select F_QUALCOMM_BWC_VIDEO_DISPLAY_HALT
endif

if MACH_MSM8974_EF63L
config DEFINE_LIST_EF63L
	bool
	default y
	select F_SKYDISP_EF63_SS
	select F_SKYDISP_HBM_FOR_AMOLED
	select F_SKYDISP_ELVSS_WORK
	select F_SKYDISP_SMARTDIMMING
	select F_SKYDISP_EF63_DRIVER_IC_CHECK
	select F_SKYDISP_AMOLED_READ_DATA
	select F_QUALCOMM_BWC_VIDEO_DISPLAY_HALT
endif

if MACH_MSM8974_EF63S
config DEFINE_LIST_EF63S
	bool
	default y
	select F_SKYDISP_EF63_SS
	select F_SKYDISP_HBM_FOR_AMOLED
	select F_SKYDISP_ELVSS_WORK
	select F_SKYDISP_SMARTDIMMING
	select F_SKYDISP_EF63_DRIVER_IC_CHECK
	select F_SKYDISP_AMOLED_READ_DATA
	select F_QUALCOMM_BWC_VIDEO_DISPLAY_HALT
endif

##############################################################
##############################################################
#               PANTECH  FEARTURE                            #
#                                                            #
##############################################################
##############################################################

##############################################################
# owner  : p10443
# date    : 2013.11.26
# PLM    :
# Case  :
# Description : EF63 Series model LCD common
##############################################################
config F_SKYDISP_EF63_SS
	bool

##############################################################
# owner  : p13832   seunghwa_ji
# date    : 2013.04.11
# PLM    :
# Case  :
# Description : it is for cabc control
##############################################################
config F_SKYDISP_CABC_CONTROL
	bool

##############################################################
# owner  : p13832 seunghwa_ji
# date    : 2013.04.30
# PLM    :
# Case  :
# Description :  it's for silentboot
##############################################################
config F_SKYDISP_SILENT_BOOT
	bool

##############################################################
# owner  : p13447 shin jaegon
# date    : 2013.05.02
# PLM    :
# Case  :
# Description : Added codes for factory command ("FACTORY_SLEEP_ENABLE_I")
##############################################################
config F_SKYDISP_FACTORY_SLEEP_ENABLE
	bool

##############################################################
# owner  : p10443
# date    : 2013.06.27
# PLM    :
# Case  :
# Description : EF56/EF59/EF60/61/62 sharpness control
##############################################################
config F_SKYDISP_SHARPNESS_CTRL
	bool

##############################################################
# owner  : p13832
# date    : 2013.07.02
# PLM    :
# Case  :
# Description : LCD cmds Test
##############################################################
config F_SKYDISP_CMDS_CONTROL
	bool

##############################################################
# owner  : p13832
# date    : 2013.08.19
# PLM    :
# Case  :
# Description : backlight on/off
##############################################################
config F_SKYDISP_BACKLIGHT_CMDS_CTL
	bool

##############################################################
# owner  : p13832
# date    : 2014.01.23
# PLM    :
# Case  :
# Description : oled hbm on/off
##############################################################
config F_SKYDISP_HBM_FOR_AMOLED
	bool

##############################################################
# owner  : p13832
# date    : 2014.01.28
# PLM    :
# Case  :
# Description : oled elvss porting
##############################################################
config F_SKYDISP_ELVSS_WORK
	bool

##############################################################
# owner  : p13832
# date    : 2014.02.04
# PLM    :
# Case  :
# Description : oled smart dimming
##############################################################
config F_SKYDISP_SMARTDIMMING
	bool

##############################################################
# owner  : p12452
# date    : 2014.03.04
# PLM    :
# Case  :
# Description : driver ic manufacture_id check
##############################################################
config F_SKYDISP_EF63_DRIVER_IC_CHECK
	bool


##############################################################
# owner  : p13832
# date    : 2014.03.011
# PLM    :
# Case  :
# Description : driver ic read(register)
##############################################################
config F_SKYDISP_AMOLED_READ_DATA
	bool


##############################################################
##############################################################
#               QUALCOMM FEARTURE                 	     #
#							     #
##############################################################
##############################################################

##############################################################
# owner  : p10443
# date    : 2014.01.24
# PLM    :
# Case  : #1430521
# Description : video player halt (1080*1920 -> 1080*607 resize play)
# TODO : official patch release check - OK (2014.01.27 official patch release)
##############################################################
config F_QUALCOMM_VIDEO_PLAYER_HALT
	bool

##############################################################
# owner  : p12226
# date    : 2013.08.28
# PLM    :
# Case  :  none
# Description : mdp ab value adjusting
##############################################################
config F_SKYDISP_ADJUST_MDP_BANDWIDTH
	bool

##############################################################
# owner  : p10443
# date    : 2013.11.04
# PLM    : EF60S PLM601
# Case  :
# Description : Surfaceflinger pending cpu 90%  framework reset
##############################################################
config F_QUALCOMM_BUGFIX_SURFACEFLINGER_PENDING
	bool

##############################################################
# owner  : p12452, Cho kyoungku
# date    : 2014.04.15
# PLM    : EF63L 1384
# Case  :  #01498672
# Description : kgsl kgsl-3d0: |kgsl_pwrctrl_pwrrail| cx regulator_enable failed: -110
#			 https://www.codeaurora.org/patches/quic/la/PATCH_8x74_25947_gdsc_remove_timeout_20130419.tar.gz
# Related file : kernel\arch\arm\mach-msm\gdsc.c
##############################################################
config F_QUALCOMM_WORKAROUND_FOR_GDSC_OXILI_FAIL
	bool

##############################################################
# owner  : p16603
# date   : 2014.02.03
# PLM    : EF61K_KK PLM146
# Case   : #01435555
# Description : Bluscreen shown in voice recoder with rotation
##############################################################
config F_QUALCOMM_BUGFIX_MDP_UNDERRUN
	bool

##############################################################
# owner  : p14974
# date    : 2014.04.15
# PLM    : EF59S_KK 583
# Case  : 01518153
# Description : move mdp clk margin calculation on individual pipe
#               so that enable individual pipe decimation
##############################################################
config F_QUALCOMM_MOVIE_PLAYER_MDP_UNDERRUN
	bool "msm: mdss: calculate mdp clk requirement of each pipe with the fudge factor"

##############################################################
# owner  : p10443
# date    : 2014.07.29
# PLM    : EF63K PLM_2282
# Case  : 01629276
# Description : video play <-> recent app display halt
##############################################################
config F_QUALCOMM_BWC_VIDEO_DISPLAY_HALT
	bool "msm: mdss: Remove init phase programming"

###################################################################
# owner  : p14974
# date    : 2014.10.16
# PLM    : Market Issue
# Case  : 01753421
# Description : force mdp clock on when display kickoff is started
###################################################################
config F_SKYDISP_FIX_PINGPONG_TIMEOUT_BY_CLOCK
	bool "msm: mdss: keep clocks on during kickoff operation"

endmenu

endif
```
