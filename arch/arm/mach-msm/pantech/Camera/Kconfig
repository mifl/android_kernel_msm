## arch/arm/mach-msm/pantech/data/Kconfig
```kconfig
if CUST_PANTECH_H

#ifdef FEATURE_SKY_DS_KERNEL_CONFIG

menu "SKY Data Kernel Configuration"

config MACH_MSM8974_DATA_COMMON
	bool
	default y
	select SKY_DS_TETHEER_MSS
	select SKY_DS_VPN
	select SKY_DS_IPSEC
	select SKY_DS_BAM_ADAPTIVE_TIMER_OFF
	select SKY_DS_ACCEPT_SIP_LAGRE_PACKET
	select SKY_DS_TCP_INIFINITE_LOOP_BUG_FIX
	select SKY_DS_KERNEL_CRASH_DUT_TO_NULL_POINTER
	select SKY_DS_ANDROID_SECURITY_PATCH_CVE_2014_2851
	select SKY_DS_ANDROID_SECURITY_PATCH_CVE_2014_4943

if MACH_MSM8974_EF63K
config DEFINE_LIST_EF63K
	bool
	default y
	select SKY_DS_DEFAULT_CONGESTION_CONTROL
	select SKY_DS_SUPPORT_TUN
	select SKY_DS_SUPPORT_BACKGROUND_TRFFIC_CONTROL_AGENT
	select SKY_DS_CTS_LOCALHOST
	select SKY_DS_CHANGE_RNDIS_MTU
endif

if MACH_MSM8974_EF63L
config DEFINE_LIST_EF63L
	bool
	default y
	select LGU_DS_TCP_SYN_RETRANSMIT
	select SKY_DS_OPTIMIZE_IPV6_ASSIGNMENT
	select SKY_DS_OPTIMIZE_IPV6_ASSIGNMENT_CRASH_FIX
endif

if MACH_MSM8974_EF63S
config DEFINE_LIST_EF63S
	bool
	default y
	select SKY_DS_DEFAULT_CONGESTION_CONTROL
	select SKY_DS_SUPPORT_TUN
	select SKY_DS_SUPPORT_BACKGROUND_TRFFIC_CONTROL_AGENT
	select SKY_DS_CTS_LOCALHOST
	select SKY_DS_CHANGE_RNDIS_MTU
	select SKY_DS_OPTIMIZE_IPV6_ASSIGNMENT
	select SKY_DS_OPTIMIZE_IPV6_ASSIGNMENT_CRASH_FIX
endif

config SKY_DS_DEFAULT_CONGESTION_CONTROL
	bool "default congestion control setting"
	default n
	select TCP_CONG_ADVANCED
	select DEFAULT_BIC
	select TCP_CONG_BIC
	help

config DEFAULT_TCP_CONG
	string
	depends on SKY_DS_DEFAULT_CONGESTION_CONTROL
	default "bic"
	help

config LGU_DS_TCP_SYN_RETRANSMIT
	bool "TCP SYN RETRANSMIT"
	default n
	help
	  Select if you want to change RTO and TCP_SYN_RETRIES when TCP syn transfer
	  tcp resync nymber is 5.(first transfer, 1s, 2s, 4s, 8s)

config SKY_DS_TETHEER_MSS
	bool "enable CONFIG_NETFILTER about TCP MSS"
	default n
	select NETFILTER_XT_TARGET_TCPMSS
	select NETFILTER_XT_MATCH_TCPMSS
	help

config SKY_DS_VPN
	bool "VPN"
	default n
	select NET_KEY
	select INET_ESP
	select INET_IPCOMP
	select XFRM
	select XFRM_USER
	select INET_XFRM_MODE_TRANSPORT
	select INET_XFRM_MODE_TUNNEL
	select CRYPTO
	select CRYPTO_HMAC
	select CRYPTO_XCBC
	select CRYPTO_NULL
	select CRYPTO_MD5
	select CRYPTO_SHA1
	select CRYPTO_DES
	select CRYPTO_AES
	select CRYPTO_DEFLATE
	select IP_ADVANCED_ROUTER
	select IP_MULTIPLE_TABLES
	select PPP
	select PPP_ASYNC
	select PPP_SYNC_TTY
	select PPP_DEFLATE
	select PPP_BSDCOMP
	select PPP_MPPE
	select PPPOE
	select PPPOL2TP
	select L2TP
	select L2TP_V3
	select L2TP_IP
	select L2TP_ETH
	select PPPOLAC
	select PPPOPNS
	help

config SKY_DS_IPSEC
	bool "enable INET CONFIG for IP SEC"
	default n
	select INET_AH
	select INET_XFRM_TUNNEL
	help

config SKY_DS_SUPPORT_TUN
	bool "support for tun driver"
	default n
	select TUN
	help

config SKY_DS_SUPPORT_BACKGROUND_TRFFIC_CONTROL_AGENT
	bool "support for advanced netfilter"
	default n
	select NETFILTER_ADVANCED
	help

config SKY_DS_CTS_LOCALHOST
	bool "support for traffic statistic each uid"
	default n
	select UID_STAT
	help

config SKY_DS_BAM_ADAPTIVE_TIMER_OFF
	bool "BAN ADAPTIVE TIMER DISABLE"
	default n
	help
	  DL Throughput

config SKY_DS_CHANGE_RNDIS_MTU
	bool "changed rndis mtu size to 1440 or 1450"
	default n
	help

config SKY_DS_ACCEPT_SIP_LAGRE_PACKET
	bool "accept SIP packet over MTU size"
	default n
	help
	  https://www.codeaurora.org/cgit/quic/la/kernel/msm/commit/?id=9736cb3f9aa9c620965d937f4ff0261f6ac32ee1
	  This config it must be eliminated because is used in all devices.
	  Already applied in the kernel history.

config SKY_DS_TCP_INIFINITE_LOOP_BUG_FIX
	bool "tcp: Avoid infinite loop on recvmsg bug"
	default n
	help
	  https://www.codeaurora.org/cgit/quic/la/kernel/msm/commit/?id=d90b9d57d2c072802aefc73752239da13fde96ad
	  This config it must be eliminated because is used in all devices.
	  Already applied in the kernel history.

config SKY_DS_KERNEL_CRASH_DUT_TO_NULL_POINTER
	bool "ping: prevent NULL pointer dereference on write to msg_name"
	default n
	help
	  https://www.codeaurora.org/cgit/quic/la/kernel/msm/commit/?id=537c27c3729a4cf4d22d556bcbc3142a31d2c834
	  This config it must be eliminated because is used in all devices.
	  Already applied in the kernel history.

config SKY_DS_OPTIMIZE_IPV6_ASSIGNMENT
	bool "IPv6 Address Asignment"
	default n
	help

config SKY_DS_OPTIMIZE_IPV6_ASSIGNMENT_CRASH_FIX
	bool "net/ipv6/addrconf: fix wdog_bark caused by infinite spinning on a deadlock"
	depends on SKY_DS_OPTIMIZE_IPV6_ASSIGNMENT
	default n
	help
	  Device crashed when optimizing IPv6 address assignment which means reducing assignment duration.
	  It's crashed because 'ifa->idev' is null at 'if6_get_first' function.
	  https://www.codeaurora.org/cgit/quic/la/kernel/msm/commit/?id=b624ab52a79d040e5f6b725baef642f5ab9615a8
	  This config it must be eliminated because is used in all devices.
	  Already applied in the kernel history.

config SKY_DS_ANDROID_SECURITY_PATCH_CVE_2014_2851
	bool "net: ipv4: current group_info should be put after using."
	default n
	help
	  Plug a group_info refcount leak in ping_init.
	  group_info is only needed during initialization and
	  the code failed to release the reference on exit.
	  While here move grabbing the reference to a place
	  where it is actually needed.
	  https://www.codeaurora.org/cgit/quic/la/kernel/msm/commit/?id=314b255f44369d198f480e7c1609edac48dfebda
	  This config it must be eliminated because is used in all devices.
	  Already applied in the kernel history.

config SKY_DS_ANDROID_SECURITY_PATCH_CVE_2014_4943
	bool "net/l2tp: don't fall back on UDP [get|set]sockopt"
	default n
	help
	  The l2tp [get|set]sockopt() code has fallen back to the UDP functions
	  for socket option levels != SOL_PPPOL2TP since day one, but that has
	  never actually worked, since the l2tp socket isn't an inet socket.
	  https://git.kernel.org/cgit/linux/kernel/git/torvalds/linux.git/commit/?id=3cf521f7dc87c031617fd47e4b7aa2593c2f3daf
	  This config it must be eliminated because is used in all devices.
	  Already applied in the kernel history.

endmenu

#endif /* FEATURE_SKY_DS_KERNEL_CONFIG */

endif
```

## arch/arm/mach-msm/pantech/pmic/Kconfig
```kconfig
if CUST_PANTECH_H

comment "PANTECH PMIC Kernel Configuration"

config MACH_MSM8974_PMIC_COMMON
	bool
	default y
	select PANTECH_PMIC_CHARGER_OFFLINE
	select PANTECH_PMIC_BOOT_POWER_ON_PROCESS
	select PANTECH_PMIC_PMIC_HW_REVISION
	select PANTECH_PMIC_SHARED_DATA
	select PANTECH_PMIC_BMS_TEST
	select PANTECH_PMIC_HW_REVISION
	select PANTECH_PMIC
	select PANTECH_PMIC_MONITOR_TEST
	select PANTECH_PMIC_MAX17058
	select PANTECH_PMIC_BOOT_CHARGER_NO_WAIT
	select PANTECH_PMIC_UVLO
	select PANTECH_PMIC_I2C_LOCK
	select PANTECH_PMIC_AUTO_PWR_ON

if MACH_MSM8974_EF63K
config DEFINE_LIST_EF63K
	bool
	default y
	select PANTECH_PMIC_RTC_ALM_OFF
	select PANTECH_PMIC_BOARD_TYPE
endif

if MACH_MSM8974_EF63L
config DEFINE_LIST_EF63L
	bool
	default y
	select PANTECH_PMIC_RTC_ALM_OFF
	select PANTECH_PMIC_BOARD_TYPE
endif

if MACH_MSM8974_EF63S
config DEFINE_LIST_EF63S
	bool
	default y
	select PANTECH_PMIC_RTC_ALM_OFF
	select PANTECH_PMIC_BOARD_TYPE
endif

#
config PANTECH_PMIC_CHARGER_OFFLINE
	bool

#
config PANTECH_PMIC_BOOT_POWER_ON_PROCESS
	bool

# PMIC HW rev
config PANTECH_PMIC_PMIC_HW_REVISION
	bool

#
config PANTECH_PMIC_SHARED_DATA
	bool

#
config PANTECH_PMIC_BMS_TEST
	bool

#
config PANTECH_PMIC_HW_REVISION
	bool

#
config PANTECH_PMIC
	bool

#
config PANTECH_PMIC_MONITOR_TEST
	bool

#
config PANTECH_PMIC_MAX17058
	bool

# auto trickle disable
config PANTECH_PMIC_BOOT_CHARGER_NO_WAIT
	bool

# charging limitation with LCD ON
config PANTECH_PMIC_UVLO
	bool

# It will protected i2c transport
config PANTECH_PMIC_I2C_LOCK
	bool

# 10% offline charging Auto power on
config PANTECH_PMIC_AUTO_PWR_ON
	bool

# this is used in rtc.h, rtc-dev.c, qpnp-rtc.c
config PANTECH_PMIC_RTC_ALM_OFF
	bool

# recognizing HW rev(S/K/L) by PMIC gpios.
config PANTECH_PMIC_BOARD_TYPE
	bool

endif
```

## arch/arm/mach-msm/pantech/sensor/Kconfig
```kconfig
if CUST_PANTECH_H

if MACH_MSM8974_EF63K
config DEFINE_LIST_EF63K
	bool
	default y
	select PANTECH_SENSOR_SLEEP_STATUS
endif

if MACH_MSM8974_EF63L
config DEFINE_LIST_EF63L
	bool
	default y
	select PANTECH_SENSOR_SLEEP_STATUS
endif

if MACH_MSM8974_EF63S
config DEFINE_LIST_EF63S
	bool
	default y
	select PANTECH_SENSOR_SLEEP_STATUS
endif

config PANTECH_SENSOR_SLEEP_STATUS
	bool

endif
```
